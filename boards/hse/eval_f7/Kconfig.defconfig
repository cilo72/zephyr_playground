## boards/hse/eval_f7/Kconfig.defconfig
```kconfig
# STM32F767ZI Nucleo board configuration

# Copyright (c) 2019 Roland Ma
# SPDX-License-Identifier: Apache-2.0

if BOARD_EVAL_F7

if NETWORKING

config NET_L2_ETHERNET
	default y

endif # NETWORKING

endif # BOARD_EVAL
```

## boards/hse/eval_f7/Kconfig.eval_f7
```kconfig
# Copyright (c) 2019 Roland Ma
# SPDX-License-Identifier: Apache-2.0

config BOARD_EVAL_F7
	select SOC_STM32F767XX
```

## boards/hse/eval_f7/board.yml
```yaml
board:
  name: eval_f7
  full_name: HSE-5555 eval f7
  vendor: HSE
  socs:
    - name: stm32f767xx
```

## drivers/drivers/Kconfig
```kconfig
# Copyright (c) 2023 Daniel Zwirner
# SPDX-License-Identifier: MIT-0

menu "Drivers"
rsource "tmc5xxx/Kconfig"
endmenu
```

## drivers/drivers/tmc5xxx/Kconfig
```kconfig
# Copyright (c) 2023 Daniel Zwirner
# SPDX-License-Identifier: MIT-0

menuconfig TMC5XXX
	bool "TMC5XXX Driver"
	help
	  This option enables the TMC5xxx driver class.

if TMC5XXX

config TMC5XXX_INIT_PRIORITY
	int "TMC5xxx device drivers init priority"
	default KERNEL_INIT_PRIORITY_DEVICE
	help
	  TMC5xxx device drivers init priority.

module = TMC5XXX
module-str = tmc5xxx
source "subsys/logging/Kconfig.template.log_config"

config TMC5XXX_SPI
	bool "SPI-controlled LED TMC5xxx driver"
	default y
	depends on DT_HAS_TMC5XXX_SPI_ENABLED
	select SPI
	help
	  Enable this option to use the SPI-controlled TMC5xxx driver.

endif # TMC5XXX
```

## drivers/dts/bindings/tmc5xxx-spi.yaml
```yaml
# Copyright (c) 2023 Daniel Zwirner
# SPDX-License-Identifier: MIT-0

description: |
  Analog Devices TMC5XXX Stepper Motor Controller (SPI mode).
  Only register read and write functions are available.

  Example definition in devicetree:

    spi0 {
      tmc5xxx: tmc5xxx@0 {
        compatible = "tmc5xxx-spi";
        reg = <0>;
        diag0-gpios = <&gpio0 13 (GPIO_ACTIVE_HIGH | GPIO_PULL_UP)>; /* Diag0 pin */
        spi-max-frequency = <DT_FREQ_M(1)>;
      };
    };

compatible: "tmc5xxx-spi"

include: spi-device.yaml

properties:
  diag0-gpios:
    type: phandle-array
    description: |
      Diagnostics output DIAG0 pin. This pin enables interrupt-based
      rampstat handling, allowing the driver to respond to motor events
      like position reached or stall detection without polling.
      Should be configured as push-pull output (active high).

  enable-gpios:
    type: phandle-array
    description: |
      Enable pin.
```

## lib/cilo72/Kconfig
```kconfig
# Copyright (c) 2021, Legrand North America, LLC.
# SPDX-License-Identifier: Apache-2.0

config CILO72
	bool "CILO72upport for custom library"
	help
	  This option enables the 'custom' library

config CILO72_MOTION
	int "CILO72custom_get_value() default return value"
	depends on CILO72
	default 0
	help
	  This option primarily exists as an example of a library Kconfig
	  setting.

	  This option specifies the value for custom_get_value() to return
	  when the input parameter is zero. (Otherwise the function returns the
	  input parameter value.)
```
